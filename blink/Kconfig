## blink/Kconfig
```kconfig
source "Kconfig.zephyr"

menuconfig LED_SUBSYSTEM
	bool "LED Subsystem"
	default y

if LED_SUBSYSTEM

choice LED_BLINK_SLEEP_TIME
	prompt "LED blink sleep time"
	default LED_BLINK_SLEEP_1S

config LED_BLINK_SLEEP_250MS
	bool "250ms"

config LED_BLINK_SLEEP_500MS
	bool "500ms"

config LED_BLINK_SLEEP_1S
	bool "1s (medium)"

config LED_BLINK_SLEEP_2S
	bool "2s"

endchoice

config BLINK_SLEEP_TIME_MS
	int
	default 250 if LED_BLINK_SLEEP_250MS
	default 500 if LED_BLINK_SLEEP_500MS
	default 1000 if LED_BLINK_SLEEP_1S
	default 2000 if LED_BLINK_SLEEP_2S

menuconfig LED_ADVANCED_SETTINGS
	bool "Advanced LED settings"

if LED_ADVANCED_SETTINGS

config LED_BRIGHTNESS
	int "LED brightness (0-100)"
	default 100
	range 0 100

config LED_FADE_DURATION
	int "LED fade duration (ms)"
	default 500
	range 0 500

endif

menu "Expert settings"
	visible if LED_SUBSYSTEM

config LED_DEBUGGING
	bool "Enable LED debugging"

config LED_CUSTOM_BLINK_PATTERN
	bool "Custom blink pattern"

endmenu

endif
```

## boards/our_board/Kconfig.defconfig
```kconfig
# Copyright (c) 2026
# SPDX-License-Identifier: Apache-2.0

if BOARD_OUR_BOARD

config SYS_CLOCK_HW_CYCLES_PER_SEC
	int
	default 125000000

config SERIAL
	bool
	default y

config CONSOLE
	bool
	default y

config UART_CONSOLE
	bool
	default y

config GPIO
	bool
	default y

config USE_DT_CODE_PARTITION
	bool
	default y

config BUILD_OUTPUT_UF2
	bool
	default y

config BUILD_OUTPUT_HEX
	bool
	default y

config UART_INTERRUPT_DRIVEN
	bool
	default y

config RESET
	bool
	default y

config CLOCK_CONTROL
	bool
	default y

config USB_SELF_POWERED
	bool
	default n

endif # BOARD_OUR_BOARD
```

## boards/our_board/board.yml
```yaml
board:
  name: our_board
  full_name: Our Board
  vendor: iomico
  socs:
    - name: rp2040
```

## modules/led_sensor/drivers/led_sensor/Kconfig
```kconfig
menuconfig LED_SENSOR
	bool "LED Sensor Driver"
	default y
	depends on DT_HAS_LED_SENSOR_ENABLED
	depends on SENSOR
	select GPIO
	help
	  Enable the on-board LED driver exposed through the sensor API.
```

## modules/led_sensor/dts/bindings/sensor/led,sensor.yaml
```yaml
description: |
  On-board LED exposed through the Zephyr sensor API.
  sensor_sample_fetch() turns the LED on, sensor_channel_get() turns it back
  off and reports the state that was last fetched.

compatible: "led,sensor"

include: base.yaml

properties:
  gpios:
    type: phandle-array
    required: true
    description: GPIO connected to the LED driven by this "sensor".
```
